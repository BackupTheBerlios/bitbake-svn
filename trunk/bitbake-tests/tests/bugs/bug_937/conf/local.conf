## trunk/bitbake-tests/tests/bugs/bug_937/conf/local.conf
```bitbake
CACHE=""
PREFERRED_VERSION_samba = "3.0.14a"
PREFERRED_VERSION_ipkg-native = "0.99.154"

DL_DIR = "/home/koen/OE/downloads"
BBFILES := "fix-mind.bb"

PREFERRED_PROVIDERS += " virtual/${TARGET_PREFIX}gcc-initial:gcc-cross-initial"
PREFERRED_PROVIDERS += " virtual/${TARGET_PREFIX}gcc:gcc-cross"
PREFERRED_PROVIDERS += " virtual/${TARGET_PREFIX}g++:gcc-cross"


PARALLEL_MAKE="-j2"

MACHINE = "c7x0"
DISTRO = "angstrom-2006.9"
```
